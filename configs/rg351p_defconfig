## configs/rg351p_defconfig
```kconfig
BR2_aarch64=y
BR2_cortex_a35=y
BR2_ARM_FPU_NEON_FP_ARMV8=y
BR2_OPTIMIZE_FAST=y
BR2_TOOLCHAIN_BUILDROOT_GLIBC=y
BR2_KERNEL_HEADERS_4_4=y
BR2_BINUTILS_VERSION_2_35_X=y
BR2_GCC_VERSION_10_X=y
BR2_TOOLCHAIN_BUILDROOT_CXX=y
BR2_GCC_ENABLE_LTO=y
BR2_ROOTFS_DEVICE_CREATION_DYNAMIC_EUDEV=y
BR2_ROOTFS_OVERLAY="board/rockchip/rg351p/rootfs"
BR2_PACKAGE_ALSA_UTILS=y
BR2_PACKAGE_ALSA_UTILS_ALSACONF=y
BR2_PACKAGE_ALSA_UTILS_AMIXER=y
BR2_PACKAGE_ALSA_UTILS_APLAY=y
BR2_PACKAGE_ALSA_UTILS_SPEAKER_TEST=y
BR2_PACKAGE_ATEST=y
BR2_PACKAGE_FLUIDLITE=y
BR2_PACKAGE_MPG123=y
BR2_PACKAGE_BZIP2=y
BR2_PACKAGE_GDB=y
BR2_PACKAGE_GDB_DEBUGGER=y
BR2_PACKAGE_GDB_TUI=y
BR2_PACKAGE_VALGRIND=y
BR2_PACKAGE_EXFAT=y
BR2_PACKAGE_EXFAT_UTILS=y
BR2_PACKAGE_LIBRGA=y
BR2_PACKAGE_LIBGO2=y
BR2_PACKAGE_SDL=y
# BR2_PACKAGE_SDL_FBCON is not set
BR2_PACKAGE_SDL_GFX=y
BR2_PACKAGE_SDL_IMAGE=y
BR2_PACKAGE_SDL_IMAGE_GIF=y
BR2_PACKAGE_SDL_IMAGE_JPEG=y
BR2_PACKAGE_SDL_IMAGE_PNG=y
BR2_PACKAGE_SDL_MIXER=y
BR2_PACKAGE_SDL_MIXER_MIDI_TIMIDITY=y
BR2_PACKAGE_SDL_NET=y
BR2_PACKAGE_SDL_SOUND=y
BR2_PACKAGE_SDL_SOUND_PLAYSOUND=y
BR2_PACKAGE_SDL_TTF=y
BR2_PACKAGE_SDL2=y
BR2_PACKAGE_SDL2_KMSDRM=y
BR2_PACKAGE_SDL2_OPENGLES=y
BR2_PACKAGE_SDL2_GFX=y
BR2_PACKAGE_SDL2_IMAGE=y
BR2_PACKAGE_SDL2_MIXER=y
BR2_PACKAGE_SDL2_NET=y
BR2_PACKAGE_SDL2_TTF=y
BR2_PACKAGE_RG351EXTRA=y
BR2_PACKAGE_PCIUTILS=y
BR2_PACKAGE_LUAJIT=y
BR2_PACKAGE_LUAJIT_COMPAT52=y
BR2_PACKAGE_LIBMIKMOD=y
BR2_PACKAGE_LIBSAMPLERATE=y
BR2_PACKAGE_LIBSNDFILE=y
BR2_PACKAGE_LIBVORBIS=y
BR2_PACKAGE_OPENAL=y
BR2_PACKAGE_OPUS_FIXED_POINT=y
BR2_PACKAGE_OPUSFILE=y
BR2_PACKAGE_PORTAUDIO=y
BR2_PACKAGE_TREMOR=y
BR2_PACKAGE_ZLIB_NG=y
BR2_PACKAGE_LIBDRM=y
BR2_PACKAGE_PIXMAN=y
BR2_PACKAGE_JSON_C=y
BR2_PACKAGE_LIBXML2=y
BR2_PACKAGE_TINYXML2=y
BR2_PACKAGE_YAML_CPP=y
BR2_PACKAGE_ENET=y
BR2_PACKAGE_LIBEVDEV=y
BR2_PACKAGE_FMT=y
BR2_PACKAGE_ICU=y
BR2_PACKAGE_LIBOPK=y
BR2_PACKAGE_WPA_SUPPLICANT=y
BR2_PACKAGE_WPA_SUPPLICANT_AUTOSCAN=y
BR2_PACKAGE_WPA_SUPPLICANT_WPS=y
BR2_PACKAGE_WPA_SUPPLICANT_WPA3=y
BR2_PACKAGE_WPA_SUPPLICANT_CLI=y
BR2_PACKAGE_WPA_SUPPLICANT_WPA_CLIENT_SO=y
BR2_PACKAGE_WPA_SUPPLICANT_PASSPHRASE=y
BR2_PACKAGE_NANO=y
BR2_TARGET_ROOTFS_SQUASHFS=y
# BR2_TARGET_ROOTFS_TAR is not set
BR2_PACKAGE_HOST_E2FSPROGS=y
BR2_PACKAGE_HOST_KMOD=y
BR2_PACKAGE_HOST_UBOOT_TOOLS=y
```

## package/librga/Config.in
```kconfig
menuconfig BR2_PACKAGE_LIBRGA
	bool "librga"
	depends on BR2_PACKAGE_LIBDRM
	help
	  Linux Rockchip userspace utility
```

## package/rg351extra/Config.in
```kconfig
config BR2_PACKAGE_RG351EXTRA
	bool "RG351EXTRA"
	depends on BR2_aarch64 || (BR2_ARM_EABIHF && BR2_arm)
	depends on BR2_TOOLCHAIN_USES_GLIBC
	select BR2_PACKAGE_HAS_LIBEGL
	select BR2_PACKAGE_HAS_LIBGLES
	help
	  Stuff

if BR2_PACKAGE_RG351EXTRA

config BR2_PACKAGE_PROVIDES_LIBEGL
	default "rg351extra"

config BR2_PACKAGE_PROVIDES_LIBGLES
	default "rg351extra"

endif

comment "RG351 needs an ARM64 glibc toolchain"
	depends on BR2_arm
	depends on !BR2_TOOLCHAIN_USES_GLIBC || !BR2_ARM_EABIHF
```
